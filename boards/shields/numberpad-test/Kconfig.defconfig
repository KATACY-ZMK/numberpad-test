## boards/shields/numberpad-test/Kconfig.defconfig
```kconfig
if SHIELD_NUMBERPADTEST
  config ZMK_KEYBOARD_NAME
  default "numberpadtest"
endif
```

## config/west.yml
```yaml
manifest:
  remotes:
    - name: zmkfirmware
      url-base: https://github.com/zmkfirmware
    - name: KATATHY-ZMK
      url-base: https://github.com/KATACY-ZMK
    - name: caksoylar  # <-- RGB LED
      url-base: https://github.com/caksoylar  
  projects:
    - name: zmk
      remote: zmkfirmware
      revision: main
      import: app/west.yml
  self:
    path: config
```
